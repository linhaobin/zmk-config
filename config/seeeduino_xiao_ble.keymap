/* source key position labels */
#include "zmk-helpers/key-labels/42.h"

/* map extra keys */
#define X_LH  &kp LGUI      // thumb row, left
#define X_RH  &smart_mouse  // thumb row, right

#define X_LT  &kp TAB
#define X_LM  &kp ESC
#define X_LB  &kp LShft

#define X_RT  &kp BACKSLASH
#define X_RM  &none
#define X_RB  &kp RShft

/* activate bluetooth */
#define CONFIG_WIRELESS 1

/* source the main keymap */
#include "base.keymap"
